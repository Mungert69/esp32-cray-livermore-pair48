## main/Kconfig
```kconfig
menu "Benchmark Selection"

choice
    prompt "Benchmark to run"
    default BENCHMARK_TYPE_CRAY

config BENCHMARK_TYPE_CRAY
    bool "Cray SAXPY benchmark (cray_benchmark.c)"

config BENCHMARK_TYPE_LIVERMORE
    bool "Livermore Kernels 1-14 benchmark (components/livermore)"

endchoice

endmenu
```

## sdkconfig.defaults
```kconfig
# ESP32-S3 default configuration for Cray benchmark
CONFIG_IDF_TARGET="esp32s3"
CONFIG_IDF_TARGET_ESP32S3=y

# Basic performance configuration - match NetworkMonitor project
CONFIG_ESPTOOLPY_FLASHFREQ_80M=y
CONFIG_ESPTOOLPY_FLASHMODE_QIO=y
CONFIG_ESPTOOLPY_FLASHSIZE_16MB=y

# Use maximum CPU frequency (240 MHz)
CONFIG_ESP_DEFAULT_CPU_FREQ_MHZ_240=y
CONFIG_ESP_DEFAULT_CPU_FREQ_MHZ=240

# Disable watchdogs for benchmark
CONFIG_ESP_TASK_WDT=y
CONFIG_ESP_TASK_WDT_TIMEOUT_S=30
CONFIG_ESP_TASK_WDT_CHECK_IDLE_TASK_CPU0=y
CONFIG_ESP_TASK_WDT_CHECK_IDLE_TASK_CPU1=y
CONFIG_ESP_PANIC_HANDLER_IRAM=y

# Enable IRAM for benchmark code
CONFIG_FREERTOS_PLACE_FUNCTIONS_INTO_IRAM=y

# Optimize for speed
CONFIG_COMPILER_OPTIMIZATION_PERF=y

# Minimal logging
CONFIG_LOG_DEFAULT_LEVEL_INFO=y
CONFIG_LOG_MAXIMUM_LEVEL_INFO=y

# PSRAM configuration - match NetworkMonitor project (OPI mode)
CONFIG_SPIRAM=y
CONFIG_SPIRAM_MODE_OCT=y
CONFIG_SPIRAM_TYPE_AUTO=y
CONFIG_SPIRAM_CLK_IO=30
CONFIG_SPIRAM_CS_IO=26
CONFIG_SPIRAM_SPEED_40M=y
CONFIG_SPIRAM_SPEED=40
CONFIG_SPIRAM_BOOT_HW_INIT=y
CONFIG_SPIRAM_BOOT_INIT=y
CONFIG_SPIRAM_PRE_CONFIGURE_MEMORY_PROTECTION=y
CONFIG_SPIRAM_USE_MALLOC=y
CONFIG_SPIRAM_MEMTEST=y
CONFIG_SPIRAM_MALLOC_ALWAYSINTERNAL=16384
CONFIG_SPIRAM_ALLOW_STACK_EXTERNAL_MEMORY=y
CONFIG_ESP32S3_SPIRAM_SUPPORT=y
CONFIG_DEFAULT_PSRAM_CLK_IO=30
CONFIG_DEFAULT_PSRAM_CS_IO=26

# Partition table - single app
CONFIG_PARTITION_TABLE_CUSTOM=y
CONFIG_PARTITION_TABLE_CUSTOM_FILENAME="partitions_single_app.csv"
CONFIG_PARTITION_TABLE_FILENAME="partitions_single_app.csv"
# Benchmark selection
# CONFIG_BENCHMARK_TYPE_CRAY is not set
CONFIG_BENCHMARK_TYPE_LIVERMORE=y
```
